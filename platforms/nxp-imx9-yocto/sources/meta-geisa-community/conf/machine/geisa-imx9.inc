## platforms/nxp-imx9-yocto/sources/meta-geisa-community/conf/machine/geisa-imx9.inc
```bitbake
# SPDX-License-Identifier: Apache-2.0

BBMULTICONFIG += "geisa-container"
MACHINEOVERRIDES =. "geisa-imx9-machine:"
WKS_FILE = "geisa-imx-partitioning.wks.in"
```

## platforms/nxp-imx9-yocto/sources/meta-geisa-community/conf/machine/geisa-imx93-6.18.inc
```bitbake
# SPDX-License-Identifier: Apache-2.0

require conf/machine/geisa-imx93.inc

GEISA_TFLITE_RUNTIME_VERSION = "2.19.0"
```

## platforms/nxp-imx9-yocto/sources/meta-geisa-community/conf/machine/geisa-imx93.inc
```bitbake
# SPDX-License-Identifier: Apache-2.0

GEISA_ACCELERATOR = "ethosu"
GEISA_ACCELERATOR_PACKAGEGROUP = "packagegroup-geisa-imx93-ethosu-dev"
GEISA_ACCELERATOR_RUNTIME = "tensorflow-lite-ethosu-delegate"
GEISA_ACCELERATOR_DEVICE_GROUP = "ethosu"
GEISA_ACCELERATOR_PROFILE = "geisa-nxp-ethosu-tflite-profile"
GEISA_ACCELERATOR_PROFILE_PATH = "/platform/profiles/nxp-ethosu-tflite"
```

## platforms/nxp-imx9-yocto/sources/meta-geisa-community/conf/machine/geisa-imx95-6.18.inc
```bitbake
# SPDX-License-Identifier: Apache-2.0

require conf/machine/geisa-imx95.inc

GEISA_TFLITE_RUNTIME_VERSION = "2.19.0"
```

## platforms/nxp-imx9-yocto/sources/meta-geisa-community/conf/machine/geisa-imx95.conf
```bitbake
# SPDX-License-Identifier: Apache-2.0

MACHINE = "geisa-imx95"
require ${GEISA_NXP_MACHINE_INCLUDE}
require conf/machine/geisa-imx9.inc
require ${GEISA_MACHINE_INCLUDE}
```

## platforms/nxp-imx93-yocto/sources/meta-geisa-community/conf/machine/geisa-imx93-6.12.49.inc
```bitbake
# SPDX-License-Identifier: Apache-2.0

require conf/machine/geisa-imx93-6.12.inc

PREFERRED_VERSION_firmware-ele-imx = "2.0.4"
PREFERRED_VERSION_firmware-imx = "8.30"
GEISA_KERNEL_VERSION = "6.12.49"
GEISA_KERNEL_SRCREV = "df24f9428e38740256a410b983003a478e72a7c0"
GEISA_UBOOT_VERSION = "2025.04"
GEISA_UBOOT_SRCREV = "4ddbad60eff308a5b356fb9ab8734ac382ddd692"
```

## platforms/nxp-imx93-yocto/sources/meta-geisa-community/conf/machine/geisa-imx93-6.12.inc
```bitbake
# SPDX-License-Identifier: Apache-2.0

# The 6.12 NXP FRDM machine owns its board-support and M33 defaults.
MACHINE_FEATURES:append = " nxpwifi-all-sdio"
PREFERRED_VERSION_firmware-ele-imx = "2.0.3"
PREFERRED_VERSION_firmware-imx = "8.29"
GEISA_TFLITE_RUNTIME_VERSION = "2.19.0"
GEISA_KERNEL_VERSION = "6.12.34"
GEISA_KERNEL_SRCREV = "be78e49cb4339fd38c9a40019df49b72fbb8bcb7"
GEISA_UBOOT_VERSION = "2025.04"
GEISA_UBOOT_SRCREV = "44898b9f3cfe5ff881c11ab1c44b714041f2b4ac"
```

## platforms/nxp-imx93-yocto/sources/meta-geisa-community/conf/machine/geisa-imx93-6.6.inc
```bitbake
# SPDX-License-Identifier: Apache-2.0

IMXBOOT_TARGETS:imx93-11x11-lpddr4x-frdm = "flash_singleboot"
BBMASK:append = " \
    meta-imx-frdm/meta-nxp-connectivity \
    meta-imx-frdm/meta-nxp-demo-experience \
    meta-imx-frdm/meta-nxp-connectivity/recipes-matter/matter/matter.bbappend \
    meta-imx-frdm/meta-nxp-connectivity/recipes-openthread/packagegroups/packagegroup-nxp-openthread.bbappend \
    meta-imx-frdm/meta-nxp-connectivity/recipes-otbr/packagegroups/packagegroup-nxp-otbr.bbappend \
    meta-imx-frdm/meta-nxp-connectivity/recipes-zigbee-rcp/packagegroups/packagegroup-nxp-zigbee-rcp.bbappend \
    meta-imx-frdm/meta-imx-bsp/recipes-connectivity/nxp-wlan-sdk/nxp-wlan-sdk_git.bbappend \
"
PREFERRED_VERSION_firmware-ele-imx = "2.0.3.1"
WKS_FILE_DEPENDS:remove:imx93-11x11-lpddr4x-frdm = "imx-m33-demos"
IMAGE_BOOT_FILES:remove:imx93-11x11-lpddr4x-frdm = " \
    imx93-11x11-evk_m33_TCM_power_mode_switch.bin \
    imx93-11x11-evk_m33_TCM_rpmsg_lite_pingpong_rtos_linux_remote.bin \
    imx93-11x11-evk_m33_TCM_rpmsg_lite_str_echo_rtos.bin \
"
```

## platforms/nxp-imx93-yocto/sources/meta-geisa-community/conf/machine/geisa-imx93.inc
```bitbake
# SPDX-License-Identifier: Apache-2.0
#
# Copyright (C) 2025 Southern California Edison
#

BBMULTICONFIG += "geisa-container"

MACHINEOVERRIDES =. "geisa-imx93-machine:"

WKS_FILE = "geisa-imx-partitioning.wks.in"
```
