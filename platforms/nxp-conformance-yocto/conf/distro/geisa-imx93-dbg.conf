## platforms/nxp-conformance-yocto/conf/distro/geisa-imx93-dbg.conf
```bitbake
DISTROOVERRIDES  =. "geisa-imx93:"
require conf/distro/geisa-imx93.conf

DISTRO = "geisa-imx93-dbg"
DISTRO_NAME = "GEISA test distribution for debugging"
```

## platforms/nxp-conformance-yocto/conf/distro/geisa-imx93.conf
```bitbake
# Distro based on poky
require conf/distro/poky.conf

# Maintainer email
MAINTAINER = "support@savoirfairelinux.com"

# Distro description
DISTRO = "geisa-imx93"
DISTRO_NAME = "GEISA test distribution"
DISTRO_VERSION = "1.0"

# Use systemd as default
INIT_MANAGER= "systemd"

# No need for x11 and wayland
DISTRO_FEATURES:remove = "x11"
DISTRO_FEATURES:remove = "wayland"

# Active buildhistory
INHERIT += "buildhistory"
BUILDHISTORY_COMMIT = "1"

# Create /etc/build
INHERIT += "image-buildinfo"

EXTRA_IMAGE_FEATURES:append = " read-only-rootfs"
DISTRO_FEATURES:append = " virtualization"
```

## platforms/nxp-conformance-yocto/conf/layer.conf
```bitbake
# We have a conf and classes directory, add to BBPATH
BBPATH .= ":${LAYERDIR}"

# We have recipes-* directories, add to BBFILES
BBFILES += "${LAYERDIR}/recipes-*/*/*.bb \
    ${LAYERDIR}/recipes-*/*/*.bbappend"

BBFILE_COLLECTIONS += "meta-geisa-imx93-bsp"
BBFILE_PATTERN_meta-geisa-imx93-bsp= "^${LAYERDIR}/"
BBFILE_PRIORITY_meta-geisa-imx93-bsp = "60"

LAYERSERIES_COMPAT_meta-geisa-imx93-bsp = "scarthgap"
```

## platforms/nxp-conformance-yocto/conf/machine/geisa-imx93-evk.conf
```bitbake
#@TYPE: Machine
#@NAME:
#@DESCRIPTION: Machine configuration based on imx93-11x11-lpddr4x-evk

MACHINE = "geisa-imx93-evk"
require conf/machine/imx93-11x11-lpddr4x-evk.conf

PREFERRED_PROVIDER_virtual/kernel = "linux-imx"
```

## platforms/nxp-conformance-yocto/conf/machine/geisa-imx93.conf
```bitbake
#@TYPE: Machine
#@NAME:
#@DESCRIPTION: Machine configuration based on imx93frdm

MACHINE = "geisa-imx93"
require conf/machine/imx93frdm.conf

IMXBOOT_TARGETS:imx93-11x11-lpddr4x-frdm = "flash_singleboot"
```

## platforms/nxp-conformance-yocto/sources/meta-geisa-app/conf/layer.conf
```bitbake
# SPDX-License-Identifier: Apache-2.0
#
# Copyright (C) 2025 Southern California Edison
#

# We have a conf and classes directory, add to BBPATH
BBPATH .= ":${LAYERDIR}"

# We have recipes-* directories, add to BBFILES
BBFILES += "${LAYERDIR}/recipes-*/*/*.bb \
    ${LAYERDIR}/recipes-*/*/*.bbappend"

BBFILE_COLLECTIONS += "meta-geisa-app"

BBFILE_PATTERN_meta-geisa-app= "^${LAYERDIR}/"
BBFILE_PRIORITY_meta-geisa-app = "60"

LAYERSERIES_COMPAT_meta-geisa-app = "scarthgap"
```

## platforms/nxp-conformance-yocto/sources/meta-geisa-bsp/conf/layer.conf
```bitbake
# We have a conf and classes directory, add to BBPATH
BBPATH .= ":${LAYERDIR}"

# We have recipes-* directories, add to BBFILES
BBFILES += "${LAYERDIR}/recipes-*/*/*.bb \
    ${LAYERDIR}/recipes-*/*/*.bbappend"

BBFILE_COLLECTIONS += "meta-geisa-bsp"
BBFILE_PATTERN_meta-geisa-bsp= "^${LAYERDIR}/"
BBFILE_PRIORITY_meta-geisa-bsp = "60"

LAYERSERIES_COMPAT_meta-geisa-bsp = "scarthgap"
PREFERRED_VERSION_firmware-ele-imx = "2.0.2.1"
```

## platforms/nxp-conformance-yocto/sources/meta-geisa-bsp/conf/machine/geisa-imx93-evk.conf
```bitbake
#@TYPE: Machine
#@NAME:
#@DESCRIPTION: Machine configuration based on imx93-11x11-lpddr4x-evk

MACHINE = "geisa-imx93-evk"
require conf/machine/imx93-11x11-lpddr4x-evk.conf
require conf/machine/geisa-imx93.inc

PREFERRED_PROVIDER_virtual/kernel = "linux-imx"
```

## platforms/nxp-conformance-yocto/sources/meta-geisa-bsp/conf/machine/geisa-imx93.inc
```bitbake
# SPDX-License-Identifier: Apache-2.0
#
# Copyright (C) 2025 Southern California Edison
#

BBMULTICONFIG += "geisa-container"

MACHINEOVERRIDES =. "geisa-imx93-machine:"

BBMASK:append = " \
    meta-imx/ \
    meta-imx-frdm/meta-nxp-connectivity \
    meta-imx-frdm/meta-nxp-demo-experience \
"
```

## platforms/nxp-conformance-yocto/sources/meta-geisa-bsp/conf/machine/geisa-imx95-evk.conf
```bitbake
#@TYPE: Machine
#@NAME:
#@DESCRIPTION: Machine configuration based on imx95-a1-19x19-lpddr5-evk
MACHINE = "geisa-imx95-evk"
require conf/machine/imx95-a1-19x19-lpddr5-evk.conf
require conf/machine/geisa-imx95.inc

PREFERRED_PROVIDER_virtual/kernel = "linux-imx"
IMX_DEFAULT_BOOTLOADER = "u-boot-imx"
```

## platforms/nxp-conformance-yocto/sources/meta-geisa-bsp/conf/machine/geisa-imx95.inc
```bitbake
# SPDX-License-Identifier: Apache-2.0
#
# Copyright (C) 2025 Southern California Edison
#

BBMULTICONFIG += "geisa-container"

MACHINEOVERRIDES =. "geisa-imx95-machine:"

BBMASK:append = " \
    meta-imx-frdm/ \
    meta-imx/meta-imx-cockpit \
    meta-imx/meta-imx-ml \
    meta-imx/meta-imx-v2x \
"

WKS_FILE = "geisa-imx-partitioning.wks.in"
```

## platforms/nxp-conformance-yocto/sources/meta-geisa-distro/conf/distro/geisa-container.conf
```bitbake
# SPDX-License-Identifier: Apache-2.0
#
# Copyright (C) 2025 Southern California Edison
#

# Distro based on poky
require conf/distro/poky.conf

# Maintainer email
MAINTAINER = "support@savoirfairelinux.com"

# Distro description
DISTRO = "geisa-container"
DISTRO_NAME = "GEISA container distribution"
DISTRO_VERSION = "1.0"

# Use systemd as default
INIT_MANAGER= "systemd"

# No need for x11 and wayland
DISTRO_FEATURES:remove = "x11"
DISTRO_FEATURES:remove = "wayland"

# Active buildhistory
INHERIT += "buildhistory"
BUILDHISTORY_COMMIT = "1"

# Create /etc/build
INHERIT += "image-buildinfo"

EXTRA_IMAGE_FEATURES:append = " read-only-rootfs"
SKIP_META_VIRT_SANITY_CHECK = "1"
```

## platforms/nxp-conformance-yocto/sources/meta-geisa-distro/conf/distro/geisa-dev.conf
```bitbake
# SPDX-License-Identifier: Apache-2.0
#
# Copyright (C) 2025 Southern California Edison
#

DISTROOVERRIDES  =. "geisa:"
require conf/distro/geisa-prod.conf

DISTRO = "geisa-dev"
DISTRO_NAME = "GEISA test distribution for debugging"
```

## platforms/nxp-conformance-yocto/sources/meta-geisa-imx93-app/conf/layer.conf
```bitbake
# We have a conf and classes directory, add to BBPATH
BBPATH .= ":${LAYERDIR}"

# We have recipes-* directories, add to BBFILES
BBFILES += "${LAYERDIR}/recipes-*/*/*.bb \
    ${LAYERDIR}/recipes-*/*/*.bbappend"

BBFILE_COLLECTIONS += "meta-geisa-imx93-app"
BBFILE_PATTERN_meta-geisa-imx93-app= "^${LAYERDIR}/"
BBFILE_PRIORITY_meta-geisa-imx93-app = "60"

LAYERSERIES_COMPAT_meta-geisa-imx93-app = "scarthgap"
```

## platforms/nxp-conformance-yocto/sources/meta-geisa-imx93-bsp/conf/machine/geisa-imx93.conf
```bitbake
#@TYPE: Machine
#@NAME:
#@DESCRIPTION: Machine configuration based on imx93frdm

MACHINE = "geisa-imx93"
require conf/machine/imx93frdm.conf
require conf/machine/geisa-imx93.inc

IMXBOOT_TARGETS:imx93-11x11-lpddr4x-frdm = "flash_singleboot"
PREFERRED_PROVIDER_virtual/kernel = "linux-imx"

WKS_FILE_DEPENDS:remove:imx93-11x11-lpddr4x-frdm = "imx-m33-demos"
IMAGE_BOOT_FILES:remove:imx93-11x11-lpddr4x-frdm = " \
    imx93-11x11-evk_m33_TCM_power_mode_switch.bin \
    imx93-11x11-evk_m33_TCM_rpmsg_lite_pingpong_rtos_linux_remote.bin \
    imx93-11x11-evk_m33_TCM_rpmsg_lite_str_echo_rtos.bin \
"
```

## platforms/nxp-conformance-yocto/sources/meta-geisa-imx93-bsp/conf/machine/geisa-imx95.inc
```bitbake
MACHINEOVERRIDES =. "geisa-imx95-machine:"

BBMASK:append = " \
    meta-imx-frdm/ \
    meta-imx/meta-imx-cockpit \
    meta-imx/meta-imx-ml \
    meta-imx/meta-imx-v2x \
"
```

## platforms/nxp-conformance-yocto/sources/meta-geisa-imx93-distro/conf/layer.conf
```bitbake
# We have a conf and classes directory, add to BBPATH
BBPATH .= ":${LAYERDIR}"

# We have recipes-* directories, add to BBFILES
BBFILES += "${LAYERDIR}/recipes-*/*/*.bb \
    ${LAYERDIR}/recipes-*/*/*.bbappend"

BBFILE_COLLECTIONS += "meta-geisa-imx93-distro"
BBFILE_PATTERN_meta-geisa-imx93-distro= "^${LAYERDIR}/"
BBFILE_PRIORITY_meta-geisa-imx93-distro = "60"

LAYERSERIES_COMPAT_meta-geisa-imx93-distro = "scarthgap"

# Mask undefined recipes for imx93 machine
BBMASK:geisa-imx93-machine:append = " \
    meta-imx-frdm/meta-nxp-connectivity/recipes-matter/matter/matter.bbappend \
    meta-imx-frdm/meta-nxp-connectivity/recipes-openthread/packagegroups/packagegroup-nxp-openthread.bbappend \
    meta-imx-frdm/meta-nxp-connectivity/recipes-otbr/packagegroups/packagegroup-nxp-otbr.bbappend \
    meta-imx-frdm/meta-nxp-connectivity/recipes-zigbee-rcp/packagegroups/packagegroup-nxp-zigbee-rcp.bbappend \
    meta-imx-frdm/meta-imx-bsp/recipes-connectivity/nxp-wlan-sdk/nxp-wlan-sdk_git.bbappend \
"

# Mask undefined recipes for imx95 (bbappends for recipes-fsl are for the demo distro only)
BBMASK:geisa-imx95-machine:append = " \
    meta-imx/meta-imx-sdk/recipes-fsl/fsl-rc-local/fsl-rc-local.bbappend \
    meta-imx/meta-imx-sdk/recipes-fsl/images/fsl-image-multimedia.bbappend \
    meta-imx/meta-imx-sdk/recipes-fsl/images/fsl-image-machine-test.bbappend \
    meta-imx/meta-imx-sdk/recipes-fsl/packagegroup/packagegroup-fsl-gstreamer1.0.bbappend \
    meta-imx/meta-imx-sdk/recipes-fsl/packagegroup/packagegroup-fsl-tools-benchmark.bbappend \
    meta-imx/meta-imx-sdk/recipes-fsl/packagegroup/packagegroup-fsl-tools-testapps.bbappend \
    meta-imx/meta-imx-sdk/recipes-graphics/devil/devil_%.bbappend \
    meta-imx/meta-imx-sdk/dynamic-layers/virtualization-layer/recipes-fsl/packagegroup/packagegroup-fsl-tools-testapps.bbappend \
"
```
